## conf/distro/include/imx7-base.inc
```bitbake
require conf/distro/poky.conf

DISTRO = "jd2mr-base"
DISTRO_NAME = "Mr Roboto Distro Base"
DISTRO_VERSION = "2.5"

SDK_VENDOR = "-jd2mrsdk"

MAINTAINER = "JD Squared <support@jd2.com>"

TARGET_VENDOR = "-jd2mr"

DISTROOVERRIDES = "jd2mr"

# This function changes the default tune for machines which are based on armv7a
# to use common tune value
def arm_tune_handler(d):
    features = d.getVar('TUNE_FEATURES', True).split()
    if 'armv7a' in features or 'armv7ve' in features:
        tune = 'armv7athf'
        if 'bigendian' in features:
            tune += 'b'
        if 'vfpv3' in features:
            tune += '-vfpv3'
        if 'vfpv3d16' in features:
            tune += '-vfpv3d16'
        if 'neon' in features:
            tune += '-neon'
        if 'vfpv4' in features:
            tune += '-vfpv4'
    else:
        tune = d.getVar('DEFAULTTUNE', True)
    return tune

DEFAULTTUNE_jd2mr := "${@arm_tune_handler(d)}"

DISTRO_ARM_INSTRUCTION ?= "thumb"
DISTRO_ARM_INSTRUCTION_armv5 ?= "arm"
ARM_INSTRUCTION_SET_jd2mr ??= "${DISTRO_ARM_INSTRUCTION}"

# Log information on images and packages
INHERIT += "buildhistory"
BUILDHISTORY_COMMIT = "1"
```

## conf/distro/jd2mr-headless-minimal.conf
```bitbake
require conf/distro/include/imx7-base.inc

DISTRO = "jd2mr-headless-mk"
DISTRO_NAME = "Mr Roboto Headless"

# Remove a lot of poky defaults...
DISTRO_FEATURES_remove = " \
    alsa \
    bluetooth \
    wifi \
    bluez5 \
    x11 \
    wayland \
    directfb \
    vulkan \
    opengl \
    multiarch \
    "
```

## conf/distro/jd2mr-headless-mk.conf
```bitbake
require conf/distro/include/imx7-base.inc

DISTRO = "jd2mr-headless-mk"
DISTRO_NAME = "Mr Roboto Headless"

# Remove a lot of poky defaults...
DISTRO_FEATURES_remove = " \
    alsa \
    bluetooth \
    wifi \
    3g \
    nfc \
    bluez5 \
    x11 \
    wayland \
    directfb \
    vulkan \
    opengl \
    multiarch \
"
```

## conf/layer.conf
```bitbake
# We have a conf and classes directory, add to BBPATH
BBPATH .= ":${LAYERDIR}"

# We have no packages yet
#BBFILES += "${LAYERDIR}/recipes-*/*/*.bb \
#            ${LAYERDIR}/recipes-*/*/*.bbappend"

#BBFILE_COLLECTIONS += "jd2-mrroboto"
#BBFILE_PATTERN_jd2-mrroboto := "^${LAYERDIR}/"
#BBFILE_PRIORITY_jd2-mrroboto = "10"

LAYERSERIES_COMPAT_jd2-mrroboto = "sumo"
```
